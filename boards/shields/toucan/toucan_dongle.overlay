/ {
    chosen {
        zmk,kscan = &mock_kscan;
        zmk,matrix-transform = &totem_42_transform;
    };

    mock_kscan: kscan_0 {
        compatible = "zmk,kscan-mock";
        columns = <0>;
        rows = <0>;
        events = <0>;
    };
};
