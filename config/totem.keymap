
#include <behaviors.dtsi>
#include <dt-bindings/zmk/bt.h>
#include <dt-bindings/zmk/keys.h>

#define RIGHT_SIDE_KEYS 5 6 7 8 9 15 16 17 18 19 26 27 28 29 30 31 32 33 34 35 36 37
#define LEFT_SIDE_KEYS 0 1 2 3 4 10 11 12 13 14 20 21 22 23 24 25 32 33 34 35 36 37

/* Map shared 38-key layout to Totem's 38-key matrix */
#define LAYOUT_SHARED( \
    k00, k01, k02, k03, k04,    k05, k06, k07, k08, k09, \
    k10, k11, k12, k13, k14,    k15, k16, k17, k18, k19, \
    k20, k21, k22, k23, k24, k25,    k26, k27, k28, k29, k30, k31, \
    t0, t1, t2,    t3, t4, t5 \
) \
    k00 k01 k02 k03 k04    k05 k06 k07 k08 k09 \
    k10 k11 k12 k13 k14    k15 k16 k17 k18 k19 \
k20 k21 k22 k23 k24 k25    k26 k27 k28 k29 k30 k31 \
            t0  t1  t2     t3  t4  t5

/* 
 * The keymap editor requires the keymap node to be in the main file 
 * or a specifically structured include. 
 */

#include "shared.keymap"
