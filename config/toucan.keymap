
#include <behaviors.dtsi>
#include <dt-bindings/zmk/bt.h>
#include <dt-bindings/zmk/keys.h>

#define RIGHT_SIDE_KEYS 6 7 8 9 10 11 18 19 20 21 22 23 30 31 32 33 34 35 36 37 38 39 40 41
#define LEFT_SIDE_KEYS 0 1 2 3 4 5 12 13 14 15 16 17 24 25 26 27 28 29 36 37 38 39 40 41

/* Map shared 38-key layout to Toucan's 42-key matrix */
#define LAYOUT_SHARED( \
    k00, k01, k02, k03, k04,    k05, k06, k07, k08, k09, \
    k10, k11, k12, k13, k14,    k15, k16, k17, k18, k19, \
    k20, k21, k22, k23, k24, k25,    k26, k27, k28, k29, k30, k31, \
    t0, t1, t2,    t3, t4, t5 \
) \
&trans k00 k01 k02 k03 k04    k05 k06 k07 k08 k09 &trans \
&trans k10 k11 k12 k13 k14    k15 k16 k17 k18 k19 &trans \
k20    k21 k22 k23 k24 k25    k26 k27 k28 k29 k30 k31 \
            t0  t1  t2     t3  t4  t5

#include "shared.keymap"
