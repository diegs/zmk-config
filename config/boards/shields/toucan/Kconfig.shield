## config/boards/shields/toucan/Kconfig.shield
```kconfig
# Copyright (c) 2022 The ZMK Contributors
# SPDX-License-Identifier: MIT

config SHIELD_TOUCAN_DONGLE
    def_bool $(shields_list_contains,toucan_dongle)

config SHIELD_TOUCAN_LEFT_PERIPHERAL
    def_bool $(shields_list_contains,toucan_left_peripheral)

config SHIELD_TOUCAN_RIGHT_PERIPHERAL
    def_bool $(shields_list_contains,toucan_right_peripheral)
```

## config/boards/shields/toucan_dongle/Kconfig.shield
```kconfig
# Copyright (c) 2022 The ZMK Contributors
# SPDX-License-Identifier: MIT

config SHIELD_TOUCAN_DONGLE
    def_bool $(shields_list_contains,toucan_dongle)
```

## config/west.yml
```yaml
manifest:
  defaults:
    revision: v0.3
  remotes:
    - name: zmkfirmware
      url-base: https://github.com/zmkfirmware
    - name: beekeeb
      url-base: https://github.com/beekeeb
    - name: janpfischer
      url-base: https://github.com/janpfischer
    - name: rschenk
      url-base: https://github.com/rschenk
    - name: caksoylar
      url-base: https://github.com/caksoylar
    - name: geeksville
      url-base: https://github.com/geeksville
  projects:
    - name: zmk
      remote: zmkfirmware
      import: app/west.yml
    - name: zmk-dongle-screen
      remote: janpfischer
      revision: main
      path: modules/zmk-dongle-screen
    - name: zmk-component-raytac-dongle
      remote: rschenk
      path: modules/zmk-component-raytac-dongle
    - name: zmk-keyboard-toucan
      remote: beekeeb
      revision: main
      import: config/west.yml 
      path: modules/zmk-keyboard-toucan 
    - name: cirque-input-module
      remote: geeksville
      revision: toucan
      path: modules/cirque-input-module
    - name: zmk-rgbled-widget
      remote: caksoylar
      revision: v0.3
      path: modules/zmk-rgbled-widget
  self:
    path: config
```
